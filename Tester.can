/*@!Encoding:1252*/
includes
{
  
}

variables
{
  message 0X100 Testermsg;
  
  timer Testerpresent;
  
}

on timer Testerpresent
{
  setTimer(Testerpresent,4);
  init_frame();
  Testermsg.byte(0) = 0X02;
  Testermsg.byte(1) = 0X3E;
  Testermsg.byte(2) = 0X00;
  output(Testermsg);
}

on start
{
  write("Tester: started");
  write("Tester: press 't' - Extended Diagnostic session");
  write("Tester: press 'k' - CancelTimer");
  Testermsg.dlc=8;
}

on key 'k'
{
  cancelTimer(Testerpresent);
  
}

void init_frame()
{
  int i;
  for(i = 0; i < 8; i++)
  Testermsg.byte(i)=0XFF;   // make all signals zero using FF
}


on key 't'
{
  write("Tester: Request to move to Extended Diagonostic Session");
  init_frame();
  Testermsg.byte(0)=0X02;   // Here 0 = type and 2 = data length 
  Testermsg.byte(1)=0X10;    // Here 10 = service id
  Testermsg.byte(2)=0X03;    // Here 03 = Diagnostic session
  output(Testermsg);
  setTimer(Testerpresent,4);
  
}
